## firmware/ESP32S3_DataCenter/main/Kconfig.projbuild
```kconfig
menu "DT_DataCenter"

    config DT_SITE_ID
        string "Canonical site_id"
        default ""

    config DT_DEVICE_ID
        string "Canonical device_id"
        default ""

    config DT_WIFI_SSID
        string "Wi-Fi station SSID"
        default ""

    config DT_WIFI_PASSWORD
        string "Wi-Fi station password"
        default ""
        help
            Keep populated sdkconfig files local and never commit credentials.

    config DT_MQTT_BROKER_URI
        string "MQTT broker URI"
        default ""
        help
            Use mqtt:// for isolated local development or mqtts:// for TLS with
            certificate validation.

    config DT_MQTT_USERNAME
        string "MQTT username"
        default ""

    config DT_MQTT_PASSWORD
        string "MQTT password"
        default ""
        help
            Keep populated sdkconfig files local and never commit credentials.

    config DT_MQTT_RECONNECT_TIMEOUT_MS
        int "MQTT reconnect delay (milliseconds)"
        range 1000 600000
        default 10000

endmenu
```

## firmware/esp32s3_datacenter/main/Kconfig.projbuild
```kconfig
menu "DT connectivity"

    config DT_WIFI_SSID
        string "Wi-Fi station SSID"
        default ""

    config DT_WIFI_PASSWORD
        string "Wi-Fi station password"
        default ""

    config DT_MQTT_BROKER_URI
        string "MQTT broker URI"
        default ""

    config DT_MQTT_USERNAME
        string "MQTT username"
        default ""

    config DT_MQTT_PASSWORD
        string "MQTT password"
        default ""

    config DT_SITE_ID
        string "Canonical site identity"
        default ""

    config DT_DEVICE_ID
        string "Canonical device identity"
        default ""

    config DT_SHT31_A_TEMPERATURE_SENSOR_ID
        string "SHT31 A temperature sensor identity"
        default ""

    config DT_SHT31_A_TEMPERATURE_ASSET_ID
        string "SHT31 A temperature asset identity"
        default ""

    config DT_SHT31_A_HUMIDITY_SENSOR_ID
        string "SHT31 A humidity sensor identity"
        default ""

    config DT_SHT31_A_HUMIDITY_ASSET_ID
        string "SHT31 A humidity asset identity"
        default ""

    config DT_SHT31_B_TEMPERATURE_SENSOR_ID
        string "SHT31 B temperature sensor identity"
        default ""

    config DT_SHT31_B_TEMPERATURE_ASSET_ID
        string "SHT31 B temperature asset identity"
        default ""

    config DT_SHT31_B_HUMIDITY_SENSOR_ID
        string "SHT31 B humidity sensor identity"
        default ""

    config DT_SHT31_B_HUMIDITY_ASSET_ID
        string "SHT31 B humidity asset identity"
        default ""

    config DT_ACOUSTIC_RMS_SENSOR_ID
        string "Acoustic RMS dBFS sensor identity"
        default ""

    config DT_ACOUSTIC_RMS_ASSET_ID
        string "Acoustic RMS dBFS asset identity"
        default ""

    config DT_ACOUSTIC_PEAK_SENSOR_ID
        string "Acoustic peak dBFS sensor identity"
        default ""

    config DT_ACOUSTIC_PEAK_ASSET_ID
        string "Acoustic peak dBFS asset identity"
        default ""

    config DT_SNTP_SERVER
        string "SNTP server"
        default ""

endmenu
```

## firmware/esp32s3_datacenter/sdkconfig.defaults
```kconfig
CONFIG_IDF_TARGET="esp32s3"
CONFIG_ESPTOOLPY_FLASHMODE_QIO=y
CONFIG_ESPTOOLPY_FLASH_SAMPLE_MODE_STR=y
# CONFIG_ESPTOOLPY_OCT_FLASH is not set
# CONFIG_ESPTOOLPY_FLASH_MODE_AUTO_DETECT is not set
CONFIG_ESPTOOLPY_FLASHSIZE_16MB=y
CONFIG_PARTITION_TABLE_SINGLE_APP_LARGE=y
CONFIG_SPIRAM=y
CONFIG_SPIRAM_MODE_OCT=y
CONFIG_SPIRAM_TYPE_ESPPSRAM64=y
CONFIG_SPIRAM_SPEED_80M=y

CONFIG_DT_SITE_ID="campus-lab"
CONFIG_DT_DEVICE_ID="rack-controller"
CONFIG_DT_SHT31_A_TEMPERATURE_SENSOR_ID="sht31-a-temperature"
CONFIG_DT_SHT31_A_TEMPERATURE_ASSET_ID="sht31-a"
CONFIG_DT_SHT31_A_HUMIDITY_SENSOR_ID="sht31-a-humidity"
CONFIG_DT_SHT31_A_HUMIDITY_ASSET_ID="sht31-a"
CONFIG_DT_SHT31_B_TEMPERATURE_SENSOR_ID="sht31-b-temperature"
CONFIG_DT_SHT31_B_TEMPERATURE_ASSET_ID="sht31-b"
CONFIG_DT_SHT31_B_HUMIDITY_SENSOR_ID="sht31-b-humidity"
CONFIG_DT_SHT31_B_HUMIDITY_ASSET_ID="sht31-b"
CONFIG_DT_ACOUSTIC_RMS_SENSOR_ID="rack-sound-rms"
CONFIG_DT_ACOUSTIC_RMS_ASSET_ID="rack-acoustic"
CONFIG_DT_ACOUSTIC_PEAK_SENSOR_ID="rack-sound-peak"
CONFIG_DT_ACOUSTIC_PEAK_ASSET_ID="rack-acoustic"
CONFIG_DT_SNTP_SERVER="pool.ntp.org"
```
